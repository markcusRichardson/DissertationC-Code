// ===================================================================
// =============           Library and Serial Setup           =========
// ===================================================================
#include <radar.h>
#include <Adafruit_AMG88xx.h>
#include <Wire.h>
#include "PinChangeInterrupt.h"
#include <SoftwareSerial.h>

// Software serial configuration for radar module
SoftwareSerial SSerial(8, 7); // RX = pin 8, TX = pin 7
#define Serial1 SSerial       // Alias for clarity in code

// ===================================================================
// =============             General Variables                =========
// ===================================================================
bool detected = false;        // Global detection flag
int radarReading = 0;         // Stores current radar motion reading

// ===================================================================
// =============             Radar Definitions                =========
// ===================================================================
#define MESSAGE_HEAD 0x55
byte radarResponse[9];        // Incoming radar response buffer
const int responseLength = 9; // Fixed radar frame size

// ===================================================================
// =============             IR Sensor Definitions            =========
// ===================================================================
int MotionInterrupt = 9;                     // Not used here but declared
int NUM_SEGMENTS = 4;                        // Divide 8x8 matrix into 4 vertical zones
int segments[4] = {0};                       // Holds pixel counts per segment
Adafruit_AMG88xx amg;                        // IR sensor instance
int Threshold_TEMP = 20;                     // Not used here but available
int Movement_Threshold = 0;                  // Minimum hot pixels per segment
float pixels[64];                            // Current frame
float previousPixels[64];                    // For future comparison if needed
float ambientTEMP = 0;                       // Used for dynamic threshold

// ===================================================================
// =============             Radar Communication              =========
// ===================================================================

// Read radar serial response
void readRadarResponse() {
  while (Serial1.available()) {
    byte incomingByte = Serial1.read();
    if (incomingByte == MESSAGE_HEAD) {
      radarResponse[0] = incomingByte;
      for (int i = 1; i < responseLength; i++) {
        while (!Serial1.available());
        radarResponse[i] = Serial1.read();
      }
      return;
    }
  }
}

// Interpret radar frame and classify motion
void interpretResponse() {
  if (radarResponse[0] == MESSAGE_HEAD) {
    byte motionState = radarResponse[8]; // Motion type code
    switch (motionState) {
      case 0x02: detected = true; radarReading = 1; break; // Approaching
      case 0x03: detected = true; radarReading = 2; break; // Departing
      case 0x04: detected = true; radarReading = 3; break; // Sustained approach
      case 0x05: detected = true; radarReading = 4; break; // Sustained departure
      default:   detected = false; radarReading = 0; break;
    }
  }
}

// Send radar motion query (called once in setup)
void sendMotionQuery() {
  byte frame[] = {0x55, 0x07, 0x00, 0x01, 0x03, 0x07, 0x00, 0x00};
  unsigned short crc = calculateCRC16(frame, sizeof(frame) - 2);
  frame[sizeof(frame) - 2] = (crc & 0xFF);
  frame[sizeof(frame) - 1] = (crc >> 8);
  Serial1.write(frame, sizeof(frame));
}

// Send scene mode query
void sendSceneQuery() {
  byte frame[] = {0x55, 0x08, 0x00, 0x02, 0x04, 0x10, 0x01, 0x00, 0x00};
  unsigned short crc = calculateCRC16(frame, sizeof(frame) - 2);
  frame[sizeof(frame) - 2] = (crc & 0xFF);
  frame[sizeof(frame) - 1] = (crc >> 8);
  Serial1.write(frame, sizeof(frame));
}

// Send radar sensitivity configuration
void sendSensitiveQuery() {
  byte frame[] = {0x55, 0x08, 0x00, 0x02, 0x04, 0x0C, 0x03, 0x00, 0x00};
  unsigned short crc = calculateCRC16(frame, sizeof(frame) - 2);
  frame[sizeof(frame) - 2] = (crc & 0xFF);
  frame[sizeof(frame) - 1] = (crc >> 8);
  Serial1.write(frame, sizeof(frame));
}

// ===================================================================
// =============              CRC Lookup Tables               =========
// ===================================================================
const unsigned char cuc_CRCHi[256] = { 0x00, 0xC1, 0x81, 0x40, 0x01, 
0xC0, 0x80, 0x41, 0x01, 0xC0, 0x80, 0x41,
0x00, 0xC1, 0x81, 0x40, 0x01, 0xC0, 0x80, 0x41, 0x00, 0xC1, 0x81, 0x40,
0x00, 0xC1, 0x81, 0x40, 0x01, 0xC0, 0x80, 0x41, 0x01, 0xC0, 0x80, 0x41,
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0x00, 0xC1, 0x81, 0x40 };


const unsigned char cuc_CRCLo[256] = { 0x00, 0xC0, 0xC1, 0x01, 0xC3, 0x03,
0x02, 0xC2, 0xC6, 0x06, 0x07, 0xC7,
0x05, 0xC5, 0xC4, 0x04, 0xCC, 0x0C, 0x0D, 0xCD, 0x0F, 0xCF, 0xCE, 0x0E,
0x0A, 0xCA, 0xCB, 0x0B, 0xC9, 0x09, 0x08, 0xC8, 0xD8, 0x18, 0x19, 0xD9,
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0x41, 0x81, 0x80, 0x40 };

// CRC-16 checksum generator
unsigned short calculateCRC16(byte *frame, unsigned short length) {
  unsigned char crcHi = 0xFF;
  unsigned char crcLo = 0xFF;
  unsigned int index;

  while (length--) {
    index = crcLo ^ *frame++;
    crcLo = crcHi ^ cuc_CRCHi[index];
    crcHi = cuc_CRCLo[index];
  }
  return (crcLo << 8 | crcHi);
}

// ===================================================================
// =============            IR Sensor Functions               =========
// ===================================================================

// Process 8x8 heatmap and count hot pixels in 4 vertical zones
void analyzeHeatmap(float pixels[]) {
  for (int i = 0; i < NUM_SEGMENTS; i++) segments[i] = 0;

  for (int col = 0; col < 8; col++) {
    for (int row = 0; row < 8; row++) {
      int segmentIndex = row / 2;
      if (pixels[row * 8 + col] > ambientTEMP + 0.5) {
        segments[segmentIndex]++;
      }
    }
  }
}

// Check if enough movement is detected in any segment
bool isHeatDetected() {
  for (int i = 0; i < NUM_SEGMENTS; i++) {
    if (segments[i] >= Movement_Threshold) return true;
  }
  return false;
}

// ===================================================================
// =============                 Setup                        =========
// ===================================================================
void setup() {
  Serial.begin(9600);
  Serial1.begin(9600);
  Serial.print("Setup");

  // Radar configuration
  sendMotionQuery();
  sendSensitiveQuery();
  sendSceneQuery();

  // IR sensor setup
  amg.begin();
  amg.setMovingAverageMode(false);  // Faster pixel response
}

// ===================================================================
// =============                 Loop                         =========
// ===================================================================
void loop() {
  // === Radar Polling ===
  if (Serial1.available() >= responseLength) {
    readRadarResponse();
    interpretResponse();
  }

  // === IR Frame Processing ===
  amg.readPixels(pixels);
  ambientTEMP = amg.readThermistor(); // Dynamically track base temp
  delay(10);
  analyzeHeatmap(pixels);

  // === Transmission Condition ===
  if (detected && isHeatDetected()) {
    Serial.write(0xAA);         // Start byte
    Serial.write(radarReading); // Radar motion code (1–4)

    // Encode segment activity into a single byte (bitmask)
    uint8_t segmentMask = 0;
    for (int i = 0; i < NUM_SEGMENTS; i++) {
      if (segments[i] > 0) segmentMask |= (1 << i);
    }

    Serial.write(segmentMask);    // Send heatmap data (1 byte)
    Serial.write((uint8_t)0);     // Padding (can be used later)
    Serial.write(0xFF);           // End byte
  }

  // Reset detection state after transmission
  detected = false;
  radarReading = 0;
}
